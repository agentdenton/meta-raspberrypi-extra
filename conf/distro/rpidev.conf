## conf/distro/rpidev.conf
```bitbake
require conf/distro/poky.conf

DISTRO = "rpidev"
DISTRO_NAME = "Development distro for rpi"

DISTRO_FEATURES += "wifi"

SHARED_PACKAGES_DIR = "${DEPLOY_DIR_IMAGE}/shared"

RPI_SECRETS_DIR = "${SHARED_PACKAGES_DIR}/rpi-secrets"

INIT_MANAGER = "systemd"
VIRTUAL-RUNTIME_syslog = ""
VIRTUAL-RUNTIME_base-utils-syslog = ""

hostname:pn-base-files = "${DISTRO}"
```
